
/*
 * Copyright (c) 2020 The ZMK Contributors
 *
 * SPDX-License-Identifier: MIT
 */


/* THIS FILE WAS GENERATED!
 *
 * This file was generated automatically. You may or may not want to
 * edit it directly.
 */

#include <behaviors.dtsi>
#include <dt-bindings/zmk/keys.h>

/ {
    keymap {
        compatible = "zmk,keymap";


        default_layer {
            bindings = <
    &kp     &kp     &kp     &kp     &kp     &kp            &kp     &kp     &kp     &kp     &kp     &kp     &kp     &kp     &kp     &kp     &kp     &kp     &kp     &kp     &kp     &kp     &kp     &kp     &kp     &kp     &kp     &kp     &kp     &kp     &kp     &kp     &kp     &kp   &kp A     &kp
            >;
        };

        layer_Layer__1 {
            bindings = <
    &kp     &kp     &kp     &kp     &kp     &kp            &kp     &kp     &kp     &kp     &kp     &kp     &kp     &kp     &kp     &kp     &kp     &kp     &kp     &kp     &kp     &kp     &kp     &kp     &kp     &kp     &kp     &kp     &kp     &kp     &kp     &kp     &kp     &kp   &kp A     &kp
            >;
        };

    };
};
